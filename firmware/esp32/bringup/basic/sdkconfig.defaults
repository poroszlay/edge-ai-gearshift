## firmware/esp32/measurement/main/Kconfig.projbuild
```kconfig
menu "Gearshift measurement probe"
config MEASUREMENT_LIVE
    bool "Run three live windows instead of the full benchmark"
    default n
endmenu
```
